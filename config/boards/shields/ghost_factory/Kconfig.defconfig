## config/boards/shields/ghost_factory/Kconfig.defconfig
```kconfig
if SHIELD_GHOST_FACTORY_LEFT

# Name must be less than 16 characters long!
config ZMK_KEYBOARD_NAME
    default "Ghost Factory"

config ZMK_SPLIT_ROLE_CENTRAL
    default y

endif

if SHIELD_GHOST_FACTORY_LEFT || SHIELD_GHOST_FACTORY_RIGHT

config ZMK_SPLIT
    default y

endif
```

## config/boards/shields/ghost_factory/Kconfig.shield
```kconfig
config SHIELD_GHOST_FACTORY_LEFT
    def_bool $(shields_list_contains,ghost_factory_left)

config SHIELD_GHOST_FACTORY_RIGHT
    def_bool $(shields_list_contains,ghost_factory_right)
```
